## Kconfig
```kconfig
menu "Cheapino custom"

config CHEAPINO_DISPLAY_ON_LAYER
    bool "Keep display blanked except when a specific layer is active"
    depends on ZMK_DISPLAY
    default n
    help
      When enabled, the display is blanked at boot and stays off while
      typing. Activating the layer defined in CHEAPINO_DISPLAY_ON_LAYER_NUM
      wakes the display. Leaving the layer schedules a re-blank after
      CHEAPINO_DISPLAY_OFF_DELAY_MS milliseconds.

if CHEAPINO_DISPLAY_ON_LAYER

config CHEAPINO_DISPLAY_ON_LAYER_NUM
    int "Layer index that wakes the display"
    default 7

config CHEAPINO_DISPLAY_OFF_DELAY_MS
    int "Milliseconds to keep display on after leaving the layer"
    default 30000

endif # CHEAPINO_DISPLAY_ON_LAYER

endmenu
```

## boards/shields/cheapinov2/Kconfig.defconfig
```kconfig
# Copyright (c) 2022 The ZMK Contributors
# SPDX-License-Identifier: MIT
#
CONFIG_ZMK_SPLIT_BLE_CENTRAL_BATTERY_LEVEL_PROXY = Y
CONFIG_ZMK_SPLIT_BLE_CENTRAL_BATTERY_LEVEL_FETCHING = Y
CONFIG_ZMK_MOUSE=y

config ZMK_KEYBOARD_NAME
    default "Cheapino v2"
    
```

## boards/shields/cheapinov2/Kconfig.shield
```kconfig
# Copyright (c) 2022 The ZMK Contributors
# SPDX-License-Identifier: MIT

config SHIELD_CHEAPINOV2
    def_bool $(shields_list_contains,cheapinov2)
```

## config/west.yml
```yaml
manifest:
  remotes:
    - name: zmkfirmware
      url-base: https://github.com/zmkfirmware
    - name: urob
      url-base: https://github.com/urob
    - name: bluedrink9
      url-base: https://github.com/bluedrink9
  projects:
    - name: zmk
      remote: zmkfirmware
      revision: main
      import: app/west.yml
    - name: zmk-leader-key
      remote: urob
      revision: main
    - name: zmk-unicode
      remote: urob
      revision: main
    - name: zmk-poor-mans-led-indicator
      remote: bluedrink9
      revision: main
  self:
    path: config
```
